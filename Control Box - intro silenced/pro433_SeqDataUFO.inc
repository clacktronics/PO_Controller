; ADAM, EVE and a UFO

; ----------------------------------
; See pwmc_SeqMacro.inc for information on the format of the sequence data
;
; ----------------------------------



; seq 01 intro

              control 0,5
	
              hold 8
              sdat 3,0,0,0,0,0,0,0
              hold 13
              sdat 0,0,0,3,0,0,0,0
              hold 20
              sdat 0,3,0,0,0,0,0,0
              hold 43
              sdat 0,0,0,0,0,0,0,3
              hold 9
              sdat 3,0,0,0,3,3,0,0
              hold 5
              sdat 3,0,0,3,0,0,0,0
              hold 34
              sdat 0,0,0,0,0,0,0,3
              hold 26
              sdat 3,3,0,0,0,0,0,0
              hold 19
              sdat 0,0,0,0,0,3,0,0
              hold 11
              sdat 0,3,0,0,0,0,3,0
              hold 20
              sdat 0,0,0,0,0,0,0,3
              hold 2
              sdat 0,0,3,0,0,0,0,0
              hold 22
              sdat 0,0,0,0,3,0,0,0
              hold 22
              sdat 3,0,0,0,0,0,0,0
              hold 12
              sdat 0,3,0,0,0,0,0,0
              hold 2
              sdat 3,0,3,0,0,0,0,0
              hold 22
              sdat 0,3,0,3,0,0,0,0
              hold 22
              sdat 3,3,0,0,3,0,0,0
              hold 14
              sdat 0,3,0,0,0,3,0,0
              hold 9
              sdat 3,0,0,0,0,0,3,0
              hold 47
              sdat 0,3,0,0,0,0,0,3
              hold 4
              sdat 0,0,0,0,0,0,0,3
              hold 4
              sdat 0,3,0,0,0,0,0,3
              hold 37
              sdat 0,3,0,0,0,0,0,0
              hold 22
              sdat 3,0,0,0,0,0,0,0
              hold 20
              sdat 0,0,3,0,3,0,0,0
              hold 2
              sdat 0,3,0,0,0,0,0,0
              hold 2
              sdat 3,0,0,0,0,0,0,0
              hold 22
              sdat 0,0,0,0,0,3,0,0
              hold 22
              sdat 3,0,0,0,0,0,0,0
              hold 199
              sdat 0,0,0,0,0,0,0,0
              hold 12
              sdat 0,0,3,0,0,0,0,0
              hold 13
              sdat 3,0,0,0,0,3,0,0
              hold 8
              sdat 0,0,0,0,0,0,0,3
              hold 20
              sdat 0,0,0,0,3,0,0,0
              hold 43
              sdat 3,3,3,3,3,3,3,3
              hold 4
              sdat 0,0,0,0,0,3,0,0
              hold 4
              sdat 0,0,0,0,0,3,0,0
              hold 4
              sdat 3,0,3,0,0,0,0,0
              hold 4
              sdat 0,3,0,0,0,0,0,3
              hold 2
              sdat 3,0,0,0,0,3,0,0
              hold 2
              sdat 0,3,0,0,0,0,0,0
              hold 33
              sdat 0,3,3,0,0,0,0,0
              hold 9
              sdat 3,0,0,0,0,0,0,0
              hold 22
              sdat 0,0,0,0,0,0,3,3
              hold 14
              sdat 0,3,0,0,0,0,0,3
              hold 9
              sdat 3,0,0,0,0,0,0,0
              hold 22
              sdat 0,0,0,0,3,0,0,0
              hold 41
              sdat 3,3,0,0,0,0,0,0
              hold 29
              sdat 3,0,0,0,3,0,0,0
              hold 18
              sdat 0,0,3,0,0,0,0,0
              hold 48
              sdat 0,0,0,0,0,0,0,0
              hold 18
              sdat 0,3,0,0,0,0,3,0
              hold 3
              sdat 0,3,0,0,0,0,0,0
              hold 2
              sdat 0,0,0,0,3,0,0,0
              hold 4
              sdat 3,0,0,0,0,3,0,0
              hold 6
              sdat 0,0,0,3,3,0,0,0
              hold 18
              sdat 0,3,0,0,0,0,3,0
              hold 22
              sdat 0,3,0,0,3,0,0,0
              hold 14
              sdat 0,3,3,3,0,0,0,0
              hold 9
              sdat 3,0,0,3,0,0,0,0
              hold 3
              sdat 0,0,0,0,3,0,0,0
              hold 24
              sdat 0,0,0,0,3,3,0,0
              hold 15
              sdat 0,3,0,0,0,3,3,0
              hold 16
              sdat 0,3,0,0,0,0,0,0
              hold 8	
              sdat 0,0,0,0,0,0,0,0
              hold 10
              sdat 0,3,0,0,0,0,0,0
              hold 43
              sdat 0,0,0,3,0,0,0,0
              hold 22
              sdat 3,0,0,0,0,0,0,0
              hold 12
              sdat 0,0,0,0,0,0,3,0
              hold 12
              sdat 0,0,0,0,0,0,0,0
              hold 30
              sdat 0,0,0,0,0,3,0,0
              hold 20
              sdat 0,3,0,0,0,0,0,0
              hold 22
              sdat 0,0,0,3,0,0,0,3
              hold 9
              sdat 3,0,0,0,3,0,0,0
              hold 24
              sdat 3,0,0,0,0,0,0,0
              hold 2
              sdat 0,3,0,0,0,0,0,0
              hold 2
              sdat 3,0,0,0,0,0,0,0
              hold 12
              sdat 3,0,0,0,0,0,0,0
              hold 14
              sdat 0,3,0,0,0,3,0,0
              hold 16
              sdat 0,0,0,0,0,0,0,3
              hold 18
              sdat 3,0,0,0,3,3,0,0
              hold 20
              sdat 0,0,0,0,0,0,0,0
              hold 22
              sdat 3,0,0,3,0,3,0,0
              hold 2
              sdat 3,0,3,0,3,0,3,0
              hold 18
              sdat 0,0,0,3,0,0,0,0
              hold 2
              sdat 3,0,0,0,0,0,0,0
              hold 22
              sdat 0,3,0,3,0,3,0,3
              hold 18
              sdat 0,0,0,0,0,0,0,0
              hold 22
              sdat 0,3,0,0,0,0,0,0
              hold 18
              sdat 0,3,0,0,0,0,0,0
              hold 30
              sdat 0,0,0,0,3,3,0,0
              hold 2
              sdat 3,3,0,3,0,0,0,3
              hold 4
              sdat 0,0,0,0,0,3,3,0
	
              seqend

; ----------------------------------

; seq 2 single pulse

              control 0,16

              hold 20
              sdat 3,0,0,0,0,0,0,0
              hold 20
              sdat 0,0,0,0,0,0,0,0
              hold 20
              sdat 3,0,0,0,0,0,0,0
              hold 20
              sdat 0,0,0,0,0,0,0,0
              hold 20
              sdat 3,0,0,0,0,0,0,0
              hold 20
              sdat 0,0,0,0,0,0,0,0
              hold 20
              sdat 3,0,0,0,0,0,0,0
              hold 20
              sdat 0,0,0,0,0,0,0,0

              seqend

; ----------------------------------

; seq 3 round pulse 

              control 0,6

              hold 20
              sdat 3,0,0,0,0,0,0,0
              hold 20
              sdat 0,0,0,0,0,0,0,0
              hold 20
              sdat 0,3,0,0,0,0,0,0
              hold 20
              sdat 0,0,0,0,0,0,0,0
              hold 20
              sdat 0,0,3,0,0,0,0,0
              hold 20
              sdat 0,0,0,0,0,0,0,0
              hold 20
              sdat 0,0,0,3,0,0,0,0
              hold 20
              sdat 0,0,0,0,0,0,0,0
              hold 20
              sdat 0,0,0,0,3,0,0,0
              hold 20
              sdat 0,0,0,0,0,0,0,0
              hold 20
              sdat 0,0,0,0,0,3,0,0
              hold 20
              sdat 0,0,0,0,0,0,0,0
              hold 20
              sdat 0,0,0,0,0,0,3,0
              hold 20
              sdat 0,0,0,0,0,0,0,0
              hold 20
              sdat 0,0,0,0,0,0,0,3
              hold 20
              sdat 0,0,0,0,0,0,0,0

              seqend

; ----------------------------------

; seq 4 quick round pulse 

              control 0,8

              hold 20
              sdat 3,0,0,0,0,0,0,0
              hold 20
              sdat 0,3,0,0,0,0,0,0
              hold 20
              sdat 0,0,3,0,0,0,0,0
              hold 20
              sdat 0,0,0,3,0,0,0,0
              hold 20
              sdat 0,0,0,0,3,0,0,0
              hold 20
              sdat 0,0,0,0,0,3,0,0
              hold 20
              sdat 0,0,0,0,0,0,3,0
              hold 20
              sdat 0,0,0,0,0,0,0,3

             
              seqend

; ----------------------------------

; seq 5 quicker round pulse 

              control 0,2

              hold 10
              sdat 3,0,0,0,0,0,0,0
              hold 10
              sdat 0,3,0,0,0,0,0,0
              hold 10
              sdat 0,0,3,0,0,0,0,0
              hold 10
              sdat 0,0,0,3,0,0,0,0
              hold 10
              sdat 0,0,0,0,3,0,0,0
              hold 10
              sdat 0,0,0,0,0,3,0,0
              hold 10
              sdat 0,0,0,0,0,0,3,0
              hold 10
              sdat 0,0,0,0,0,0,0,3
              hold 10
              sdat 3,0,0,0,0,0,0,0
              hold 10
              sdat 0,3,0,0,0,0,0,0
              hold 10
              sdat 0,0,3,0,0,0,0,0
              hold 10
              sdat 0,0,0,3,0,0,0,0
              hold 10
              sdat 0,0,0,0,3,0,0,0
              hold 10
              sdat 0,0,0,0,0,3,0,0
              hold 10
              sdat 0,0,0,0,0,0,3,0
              hold 10
              sdat 0,0,0,0,0,0,0,3
             
              seqend

; ----------------------------------


; seq 6 quick round pulse with blip 

              control 0,22

              hold 20
              sdat 3,0,0,0,1,0,0,0
              hold 20
              sdat 0,3,0,0,0,0,0,0
              hold 20
              sdat 0,0,3,0,0,0,0,0
              hold 20
              sdat 0,0,0,3,0,0,0,0
              hold 20
              sdat 0,0,0,0,3,0,0,0
              hold 20
              sdat 0,0,0,0,0,3,0,0
              hold 20
              sdat 0,0,0,0,0,0,3,0
              hold 20
              sdat 0,0,0,0,0,0,0,3
             
              seqend

; ----------------------------------

; seq 7 quick round pulse with 2 blips 

              control 0,22

              hold 20
              sdat 3,0,0,0,1,0,0,0
              hold 20
              sdat 0,3,0,0,0,0,0,0
              hold 20
              sdat 0,0,3,0,0,0,0,0
              hold 20
              sdat 0,0,0,3,0,0,0,0
              hold 20
              sdat 2,0,0,0,3,0,0,0
              hold 20
              sdat 0,0,0,0,0,3,0,0
              hold 20
              sdat 0,0,0,0,0,0,3,0
              hold 20
              sdat 0,0,0,0,0,0,0,3
             
              seqend

; ----------------------------------
; seq 8 just 2 blips 

              control 0,8

              hold 20
              sdat 0,0,0,0,1,0,0,0
              hold 20
              sdat 0,0,0,0,0,0,0,0
              hold 20
              sdat 0,0,0,0,0,0,0,0
              hold 20
              sdat 0,0,0,0,0,0,0,0
              hold 20
              sdat 2,0,0,0,0,0,0,0
              hold 20
              sdat 0,0,0,0,0,0,0,0
              hold 20
              sdat 0,0,0,0,0,0,0,0
              hold 20
              sdat 0,0,0,0,0,0,0,0
             
              seqend

; ----------------------------------
; seq 9 just 2 blips but5 longer 

              control 0,7

              hold 20
              sdat 0,0,0,0,1,0,0,0
              hold 20
              sdat 0,0,0,0,1,0,0,0
              hold 20
              sdat 0,0,0,0,1,0,0,0
              hold 20
              sdat 0,0,0,0,0,0,0,0
              hold 20
              sdat 2,0,0,0,0,0,0,0
              hold 20
              sdat 2,0,0,0,0,0,0,0
              hold 20
              sdat 2,0,0,0,0,0,0,0
              hold 20
              sdat 0,0,0,0,0,0,0,0
             
              seqend

; ----------------------------------
; seq 10 two tone 

              control 0,1

              hold 160
              sdat 2,0,0,0,1,0,0,0

              seqend

; ----------------------------------
; seq 11  crazy thing

              control 0,1

              hold 8
              sdat 1,0,0,0,0,0,0,1
              hold 8
              sdat 0,1,0,0,0,0,1,0
              hold 8
              sdat 0,0,1,0,0,1,0,0
              hold 8
              sdat 0,0,0,1,1,0,0,0
              hold 8
              sdat 1,0,0,1,1,0,0,1
              hold 8
              sdat 0,1,0,1,1,0,1,0
              hold 8
              sdat 0,0,1,1,1,1,0,0
              hold 8
              sdat 0,0,0,2,2,0,0,0
              hold 8
              sdat 0,0,0,2,2,0,0,0
              hold 8
              sdat 1,0,0,2,2,0,0,1
              hold 8
              sdat 0,1,0,2,2,0,1,0
              hold 8
              sdat 0,0,1,2,2,1,0,0
              hold 8
              sdat 0,0,0,3,3,0,0,0
              hold 8
              sdat 1,0,0,3,3,0,0,1
              hold 8
              sdat 0,1,0,3,3,0,1,0
              hold 8
              sdat 0,0,1,3,3,1,0,0
              hold 8
              sdat 0,0,0,3,3,0,0,0 
              hold 8
              sdat 0,0,3,3,3,3,0,0
              hold 7
              sdat 0,3,3,3,3,3,3,0
              hold 6
              sdat 3,3,3,3,3,3,3,3
              hold 8
              sdat 3,3,3,2,2,3,3,3
              hold 10
              sdat 3,3,2,1,1,2,3,3
              hold 10
              sdat 3,2,1,0,0,1,2,3
              hold 10
              sdat 2,1,0,0,0,0,1,2
              hold 12
              sdat 1,0,0,0,0,0,0,1
              hold 33
              sdat 0,0,0,0,0,0,0,0

              seqend

; ----------------------------------
; seq 12 round buzz

              control 0,1

              hold 2
              sdat 3,0,0,0,0,0,0,0
              hold 2
              sdat 0,3,0,0,0,0,0,0
              hold 2
              sdat 0,0,3,0,0,0,0,0
              hold 2
              sdat 0,0,0,3,0,0,0,0
              hold 2
              sdat 0,0,0,0,3,0,0,0
              hold 2
              sdat 0,0,0,0,0,3,0,0
              hold 2
              sdat 0,0,0,0,0,0,3,0
              hold 2
              sdat 0,0,0,0,0,0,0,3
              hold 2
              sdat 3,0,0,0,0,0,0,0
              hold 2
              sdat 2,3,0,0,0,0,0,0
              hold 2
              sdat 1,2,3,0,0,0,0,0
              hold 2
              sdat 0,1,2,3,0,0,0,0
              hold 5
              sdat 0,0,1,2,3,0,0,0
              hold 7
              sdat 0,0,0,1,2,3,0,0
              hold 9
              sdat 0,0,0,0,1,2,3,0
              hold 11
              sdat 0,0,0,0,0,1,2,3
              hold 12
              sdat 0,0,0,0,0,0,1,2
              hold 14
              sdat 0,0,0,0,0,0,0,1
              hold 58
              sdat 0,0,0,0,0,0,0,1
              hold 10
              sdat 0,0,0,0,0,0,0,0
              hold 160
              sdat 0,0,0,0,0,0,0,0

              seqend


; ----------------------------------

; seq 13 beats with 2 long blips

              control 0,10

              hold 20
              sdat 3,3,0,0,1,0,0,0
              hold 20
              sdat 0,0,0,0,1,0,0,0
              hold 20
              sdat 0,0,0,0,1,3,3,0
              hold 20
              sdat 0,0,0,0,0,3,3,0
              hold 20
              sdat 2,0,0,0,0,0,0,0
              hold 20
              sdat 2,0,3,3,0,0,0,0
              hold 20
              sdat 2,0,0,0,0,0,0,0
              hold 20
              sdat 0,0,0,0,3,3,0,0

              hold 20
              sdat 0,0,0,0,1,0,0,0
              hold 20
              sdat 0,0,0,0,1,3,3,0
              hold 20
              sdat 0,0,0,0,1,0,0,0
              hold 20
              sdat 3,0,0,0,0,0,0,3
              hold 20
              sdat 2,0,0,0,0,0,0,0
              hold 20
              sdat 2,0,0,0,0,0,0,0
              hold 20
              sdat 2,0,0,0,0,0,0,0
              hold 20
              sdat 3,3,3,3,3,3,3,3

              hold 20
              sdat 0,0,0,0,1,0,0,0
              hold 20
              sdat 0,0,0,0,1,0,0,0
              hold 20
              sdat 0,3,0,0,1,0,0,0
              hold 20
              sdat 0,0,0,0,0,0,0,0
              hold 20
              sdat 2,0,0,0,3,3,0,0
              hold 20
              sdat 2,0,0,0,3,3,0,0
              hold 20
              sdat 2,0,0,0,0,0,0,0
              hold 20
              sdat 3,0,0,0,0,0,0,3

              hold 20
              sdat 3,0,0,0,1,0,0,0
              hold 20
              sdat 0,3,0,0,1,0,0,0
              hold 20
              sdat 0,0,3,0,1,0,0,0
              hold 20
              sdat 0,0,0,3,0,0,0,0
              hold 20
              sdat 2,0,0,0,3,0,0,0
              hold 20
              sdat 2,0,0,0,0,3,0,0
              hold 20
              sdat 2,0,0,0,0,0,3,0
              hold 20
              sdat 0,0,0,0,0,0,0,3
             
              seqend
; ----------------------------------
; seq 14 less beats with 2 long blips

              control 0,5

              hold 20
              sdat 3,3,0,0,1,0,0,0
              hold 20
              sdat 0,0,0,0,1,0,0,0
              hold 20
              sdat 0,0,0,0,1,0,0,0
              hold 20
              sdat 0,0,0,0,0,3,3,0
              hold 20
              sdat 2,0,0,0,0,0,0,0
              hold 20
              sdat 2,0,0,0,0,0,0,0
              hold 20
              sdat 2,0,0,0,0,0,0,0
              hold 20
              sdat 0,0,0,0,3,3,0,0

              hold 20
              sdat 0,0,0,0,1,0,0,0
              hold 20
              sdat 0,0,0,0,1,3,3,0
              hold 20
              sdat 0,0,0,0,1,0,0,0
              hold 20
              sdat 3,0,0,0,0,0,0,0
              hold 20
              sdat 2,0,0,0,0,0,0,0
              hold 20
              sdat 2,0,0,0,0,0,0,0
              hold 20
              sdat 2,0,0,0,0,0,0,0
              hold 20
              sdat 3,3,3,3,3,3,3,3

              hold 20
              sdat 0,0,0,0,1,0,0,0
              hold 20
              sdat 0,0,0,0,1,0,0,0
              hold 20
              sdat 0,0,0,0,1,0,0,0
              hold 20
              sdat 0,0,0,0,0,0,0,0
              hold 20
              sdat 2,0,0,0,3,3,0,0
              hold 20
              sdat 2,0,0,0,0,0,0,0
              hold 20
              sdat 2,0,0,0,0,0,0,0
              hold 20
              sdat 3,0,0,0,0,0,0,0

              hold 20
              sdat 3,0,0,0,1,0,0,0
              hold 20
              sdat 0,3,0,0,1,0,0,0
              hold 20
              sdat 0,0,3,0,1,0,0,0
              hold 20
              sdat 0,0,0,3,0,0,0,0
              hold 20
              sdat 2,0,0,0,3,0,0,0
              hold 20
              sdat 2,0,0,0,0,3,0,0
              hold 20
              sdat 2,0,0,0,0,0,3,0
              hold 20
              sdat 0,0,0,0,0,0,0,3
             
              seqend
; ----------------------------------
; seq 15 just loads of blips

              control 0,7

              hold 20
              sdat 0,0,0,0,1,0,0,0
              hold 20
              sdat 0,1,0,0,1,0,0,0
              hold 20
              sdat 0,0,0,0,2,0,0,0
              hold 20
              sdat 0,0,0,2,0,0,0,0
              hold 20
              sdat 2,0,0,0,0,1,0,0
              hold 20
              sdat 2,0,0,0,0,1,0,0
              hold 20
              sdat 2,0,0,0,0,0,0,0
              hold 20
              sdat 0,0,0,2,0,0,0,0

              hold 20
              sdat 0,0,0,0,1,0,0,0
              hold 20
              sdat 0,0,0,0,1,0,0,0
              hold 20
              sdat 0,0,0,0,1,0,0,0
              hold 20
              sdat 0,0,0,0,0,0,0,0
              hold 20
              sdat 2,0,0,0,0,0,0,1
              hold 20
              sdat 2,0,0,0,0,0,0,2
              hold 20
              sdat 2,0,0,0,0,0,0,0
              hold 20
              sdat 0,0,0,0,0,0,0,0

              hold 20
              sdat 0,0,0,0,1,0,0,2
              hold 20
              sdat 0,0,0,0,1,0,0,0
              hold 20
              sdat 0,0,0,0,1,0,0,0
              hold 20
              sdat 0,0,0,0,0,0,0,0
              hold 20
              sdat 2,0,0,0,0,0,0,0
              hold 20
              sdat 2,0,0,0,0,0,0,0
              hold 20
              sdat 2,0,1,0,0,0,0,0
              hold 20
              sdat 0,0,1,0,0,0,0,0

              hold 20
              sdat 0,0,0,0,1,0,0,0
              hold 20
              sdat 0,0,0,0,1,0,0,0
              hold 20
              sdat 0,0,0,0,1,0,0,0
              hold 20
              sdat 1,1,0,0,0,0,2,2
              hold 20
              sdat 2,0,0,0,0,0,0,0
              hold 20
              sdat 2,0,0,0,0,0,0,0
              hold 20
              sdat 2,0,0,0,0,0,0,0
              hold 20
              sdat 1,0,0,0,0,0,1,0
             
              seqend
; ----------------------------------
; seq 16 loads of blips with few beat

              control 0,1

              hold 20
              sdat 0,0,0,0,1,0,0,0
              hold 20
              sdat 0,1,0,0,1,0,0,0
              hold 20
              sdat 0,0,0,0,2,0,0,0
              hold 20
              sdat 0,0,0,2,0,0,0,0
              hold 20
              sdat 2,0,0,0,0,1,0,0
              hold 20
              sdat 2,0,0,0,0,1,0,0
              hold 20
              sdat 2,0,0,0,0,0,0,0
              hold 20
              sdat 0,0,0,2,0,0,0,3

              hold 20
              sdat 0,0,0,0,1,0,0,0
              hold 20
              sdat 0,0,0,0,1,0,0,0
              hold 20
              sdat 0,0,0,0,1,0,0,0
              hold 20
              sdat 0,0,0,0,0,0,0,0
              hold 20
              sdat 2,0,0,0,0,0,0,1
              hold 20
              sdat 2,0,0,0,0,0,0,2
              hold 20
              sdat 2,0,0,0,0,0,0,0
              hold 20
              sdat 0,0,0,0,0,0,0,3

              hold 20
              sdat 0,0,0,0,1,0,0,2
              hold 20
              sdat 0,0,0,0,1,0,0,0
              hold 20
              sdat 0,0,0,0,1,0,0,0
              hold 20
              sdat 0,0,0,0,0,0,0,0
              hold 20
              sdat 2,0,0,0,0,0,0,0
              hold 20
              sdat 2,0,0,0,0,0,0,0
              hold 20
              sdat 2,0,1,0,0,0,0,0
              hold 20
              sdat 0,0,1,0,0,0,0,3

              hold 20
              sdat 0,0,0,0,1,0,0,0
              hold 20
              sdat 0,0,0,0,1,0,0,0
              hold 20
              sdat 0,0,0,0,1,0,0,0
              hold 20
              sdat 1,1,0,0,0,0,2,2
              hold 20
              sdat 2,0,0,0,0,0,0,0
              hold 20
              sdat 2,0,0,0,0,0,0,0
              hold 20
              sdat 2,0,0,0,0,0,0,0
              hold 20
              sdat 1,0,0,0,0,0,1,3
             
              seqend
; ----------------------------------
; seq 17 beats with more blips

              control 0,10

              hold 20
              sdat 3,3,0,0,1,0,0,0
              hold 20
              sdat 0,1,0,0,1,0,0,0
              hold 20
              sdat 0,0,0,0,2,3,3,0
              hold 20
              sdat 0,0,0,2,0,3,3,0
              hold 20
              sdat 2,0,0,0,0,1,0,0
              hold 20
              sdat 2,0,3,3,0,1,0,0
              hold 20
              sdat 2,0,0,0,0,0,0,0
              hold 20
              sdat 0,0,0,2,3,3,0,0

              hold 20
              sdat 0,0,0,0,1,0,0,0
              hold 20
              sdat 0,0,0,0,1,3,3,0
              hold 20
              sdat 0,0,0,0,1,0,0,0
              hold 20
              sdat 3,0,0,0,0,0,0,3
              hold 20
              sdat 2,0,0,0,0,0,0,1
              hold 20
              sdat 2,0,0,0,0,0,0,2
              hold 20
              sdat 2,0,0,0,0,0,0,0
              hold 20
              sdat 3,3,3,3,3,3,3,3

              hold 20
              sdat 0,0,0,0,1,0,0,2
              hold 20
              sdat 0,0,0,0,1,0,0,0
              hold 20
              sdat 0,3,0,0,1,0,0,0
              hold 20
              sdat 0,0,0,0,0,0,0,0
              hold 20
              sdat 2,0,0,0,3,3,0,0
              hold 20
              sdat 2,0,0,0,3,3,0,0
              hold 20
              sdat 2,0,1,0,0,0,0,0
              hold 20
              sdat 3,0,1,0,0,0,0,3

              hold 20
              sdat 3,0,0,0,1,0,0,0
              hold 20
              sdat 0,3,0,0,1,0,0,0
              hold 20
              sdat 0,0,3,0,1,0,0,0
              hold 20
              sdat 1,1,0,3,0,0,2,2
              hold 20
              sdat 2,0,0,0,3,0,0,0
              hold 20
              sdat 2,0,0,0,0,3,0,0
              hold 20
              sdat 2,0,0,0,0,0,3,0
              hold 20
              sdat 1,0,0,0,0,0,1,3
             
              seqend
; ----------------------------------
; seq 18 just loads of blips

              control 0,4

              hold 20
              sdat 0,0,0,0,1,0,0,0
              hold 20
              sdat 0,1,0,0,1,0,0,0
              hold 20
              sdat 0,0,0,0,2,0,0,0
              hold 20
              sdat 0,0,0,2,0,0,0,0
              hold 20
              sdat 2,0,0,0,0,1,0,0
              hold 20
              sdat 2,0,0,0,0,1,0,0
              hold 20
              sdat 2,0,0,0,0,0,0,0
              hold 20
              sdat 0,0,0,2,0,0,0,0

              hold 20
              sdat 0,0,0,0,1,0,0,0
              hold 20
              sdat 0,0,0,0,1,0,0,0
              hold 20
              sdat 0,0,0,0,1,0,0,0
              hold 20
              sdat 0,0,0,0,0,0,0,0
              hold 20
              sdat 2,0,0,0,0,0,0,1
              hold 20
              sdat 2,0,0,0,0,0,0,2
              hold 20
              sdat 2,0,0,0,0,0,0,0
              hold 20
              sdat 0,0,0,0,0,0,0,0

              hold 20
              sdat 0,0,0,0,1,0,0,2
              hold 20
              sdat 0,0,0,0,1,0,0,0
              hold 20
              sdat 0,0,0,0,1,0,0,0
              hold 20
              sdat 0,0,0,0,0,0,0,0
              hold 20
              sdat 2,0,0,0,0,0,0,0
              hold 20
              sdat 2,0,0,0,0,0,0,0
              hold 20
              sdat 2,0,1,0,0,0,0,0
              hold 20
              sdat 0,0,1,0,0,0,0,0

              hold 20
              sdat 0,0,0,0,1,0,0,0
              hold 20
              sdat 0,0,0,0,1,0,0,0
              hold 20
              sdat 0,0,0,0,1,0,0,0
              hold 20
              sdat 1,1,0,0,0,0,2,2
              hold 20
              sdat 2,0,0,0,0,0,0,0
              hold 20
              sdat 2,0,0,0,0,0,0,0
              hold 20
              sdat 2,0,0,0,0,0,0,0
              hold 20
              sdat 1,0,0,0,0,0,1,0
             
              seqend
; ----------------------------------
; seq 19 just a little less of blips

              control 0,3

              hold 20
              sdat 0,0,0,0,1,0,0,0
              hold 20
              sdat 0,0,0,0,1,0,0,0
              hold 20
              sdat 0,0,0,0,2,0,0,0
              hold 20
              sdat 0,0,0,2,0,0,0,0
              hold 20
              sdat 2,0,0,0,0,1,0,0
              hold 20
              sdat 2,0,0,0,0,0,0,0
              hold 20
              sdat 0,0,0,0,0,0,0,0
              hold 20
              sdat 0,0,0,2,0,0,0,0

              hold 20
              sdat 0,0,0,0,1,0,0,0
              hold 20
              sdat 0,0,0,0,0,0,0,0
              hold 20
              sdat 0,0,0,0,1,0,0,0
              hold 20
              sdat 0,0,0,0,0,0,0,0
              hold 20
              sdat 2,0,0,0,0,0,0,1
              hold 20
              sdat 0,0,0,0,0,0,0,0
              hold 20
              sdat 2,0,0,0,0,0,0,0
              hold 20
              sdat 0,0,0,0,0,0,0,0

              hold 20
              sdat 0,0,0,0,1,0,0,0
              hold 20
              sdat 0,0,0,0,1,0,0,0
              hold 20
              sdat 0,0,0,0,1,0,0,0
              hold 20
              sdat 0,0,0,0,0,0,0,0
              hold 20
              sdat 2,0,0,0,0,0,0,0
              hold 20
              sdat 2,0,0,0,0,0,0,0
              hold 20
              sdat 2,0,1,0,0,0,0,0
              hold 20
              sdat 0,0,1,0,0,0,0,0

              hold 20
              sdat 0,0,0,0,1,0,0,0
              hold 20
              sdat 0,0,0,0,1,0,0,0
              hold 20
              sdat 0,0,0,0,1,0,0,0
              hold 20
              sdat 1,1,0,0,0,0,0,2
              hold 20
              sdat 0,0,0,0,0,0,0,0
              hold 20
              sdat 2,0,0,0,0,0,0,0
              hold 20
              sdat 0,0,0,0,0,0,0,0
              hold 20
              sdat 1,0,0,0,0,0,0,0
             
              seqend
; ----------------------------------
; seq 20 blip circle

              control 0,1

              hold 20
              sdat 1,0,0,0,0,0,0,0
              hold 20
              sdat 0,0,0,0,0,0,0,0
              hold 20
              sdat 0,1,0,0,0,0,0,0
              hold 20
              sdat 0,0,0,0,0,0,0,0
              hold 20
              sdat 0,0,1,0,0,0,0,0
              hold 20
              sdat 0,0,0,0,0,0,0,0
              hold 20
              sdat 0,0,0,1,0,0,0,0
              hold 20
              sdat 0,0,0,0,0,0,0,0
              hold 20
              sdat 0,0,0,0,1,0,0,0
              hold 20
              sdat 0,0,0,0,0,0,0,0
              hold 20
              sdat 0,0,0,0,0,1,0,0
              hold 20
              sdat 0,0,0,0,0,0,0,0
              hold 20
              sdat 0,0,0,0,0,0,1,0
              hold 20
              sdat 0,0,0,0,0,0,0,0
              hold 20
              sdat 0,0,0,0,0,0,0,1
              hold 20
              sdat 0,0,0,0,0,0,0,0

              seqend

; ----------------------------------

; seq 21 just two tone 

              control 0,5

              hold 160
              sdat 2,1,2,1,2,1,2,1

              seqend

; ----------------------------------
; seq 18 silence

              control 0,7

              hold 160
              sdat 0,0,0,0,0,0,0,0

              seqend

; ----------------------------------